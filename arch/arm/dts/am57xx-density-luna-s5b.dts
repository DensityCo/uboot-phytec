/*
 * Copyright (C) 2022 Density, Inc - http://www.density.io/
 *
 * DTS for Density Luna S5b
 */
/dts-v1/;

#include "dra74x.dtsi"

#include "am57xx-density-luna-s5b.dtsi"
#include "am572x-ksp-5015.dtsi"

/ {
	model = "Density Luna S5b, Industrial Temp";
	compatible = "phytec,am572x-pcm-057-factory", "phytec,am572x-ksp-5015", "ti,dra7";

	memory {
		device_type = "memory";
		reg = <0x0 0x80000000 0x0 0x20000000>; /* 512MiB */
	};
};

&qspi {
	status = "disabled";
};

&qspi_nor {
	status = "disabled";
};
