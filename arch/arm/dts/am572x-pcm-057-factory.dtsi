/*
 * Copyright (C) 2015 PHYTEC America, LLC. - www.phytec.com
 *
 * This program is free software; you can redistribute it and/or modify
 * it under the terms of the GNU General Public License version 2 as
 * published by the Free Software Foundation.
 *

 * TI AM5728 Processor
 */

/ {
	model = "PHYTEC phyCORE-AM57XX with 512MiB DDR3, Industrial Temp";
	compatible = "phytec,am572x-pcm-057-factory", "phytec,am572x-phycore-som", "ti,am5728", "ti,dra742", "ti,dra74", "ti,dra7";

	memory {
		device_type = "memory";
		reg = <0x0 0x20000000 0x0 0x0>; /* 512MiB */
	};
};

&qspi {
	status = "disabled";
};

&qspi_nor {
	status = "disabled";
};
