/*
 * Copyright (C) 2018 PHYTEC America, LLC. - https://www.phytec.com/
 *
 * This program is free software; you can redistribute it and/or modify
 * it under the terms of the GNU General Public License version 2 as
 * published by the Free Software Foundation.
 */
#include "dra74x.dtsi"
#include <dt-bindings/gpio/gpio.h>
#include <dt-bindings/interrupt-controller/irq.h>
#include "am57xx-phycore-common.dtsi"

/ {
	model = "Phytec phyCORE-AM572x";
	compatible = "phytec,am572x-phycore-som", "ti,am5728", "ti,dra742", "ti,dra74", "ti,dra7";
};
