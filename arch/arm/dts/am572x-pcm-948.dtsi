/*
 * Copyright (C) 2018 PHYTEC America, LLC. - https://www.phytec.com/
 *
 * This program is free software; you can redistribute it and/or modify
 * it under the terms of the GNU General Public License version 2 as
 * published by the Free Software Foundation.
 */

#include "am57xx-pcm-948-common.dtsi"

/ {
	model = "PHYTEC phyCORE-AM572x Carrier Board";
	compatible = "phytec,am572x-pcm-948", "phytec,am572x-phycore-som", "ti,am5728", "ti,dra742", "ti,dra74", "ti,dra7";
};
