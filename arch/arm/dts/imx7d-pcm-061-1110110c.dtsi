/*
 * Copyright (C) 2018 PHYTEC America, LLC
 *
 * This program is free software; you can redistribute it and/or modify
 * it under the terms of the GNU General Public License version 2 as
 * published by the Free Software Foundation.
 */

/ {
	model = "Phytec phyCORE-i.MX7 Dual, 512MB DDR3";
	compatible = "phytec,imx7d-pcm-061-1110110c", "phytec,imx7-phycore-som", "fsl,imx7d";

	memory {
		reg = <0x80000000 0x20000000>;	/* 512MB */
	};
};

/* NAND not populated */
&gpmi {
	status = "disabled";
};

/* No external RTC */
&i2c_rtc {
	status = "disabled";
};
