// SPDX-License-Identifier: GPL-2.0
/*
 * Copyright (C) 2018 PHYTEC America, LLC - https://www.phytec.com
 */

/dts-v1/;

#include "k3-am65xx-phycore-som-r5.dtsi"	/* Superset - enables R5 core for booting */
#include "k3-am65xx-pcm-941-r5.dtsi"		/* Carrier board */
#include "k3-am65xx-phycore-kit-u-boot.dtsi"

/ {
};
