/*
 * Copyright (C) 2018 PHYTEC America, LLC. - https://www.phytec.com/
 *
 * This program is free software; you can redistribute it and/or modify
 * it under the terms of the GNU General Public License version 2 as
 * published by the Free Software Foundation.
 */
#include "dra72x.dtsi"
#include <dt-bindings/gpio/gpio.h>
#include <dt-bindings/interrupt-controller/irq.h>
#include "am57xx-phycore-common.dtsi"

/ {
	model = "Phytec phyCORE-AM571x";
	compatible = "phytec,am571x-phycore-som", "ti,am5718", "ti,dra722", "ti,dra72", "ti,dra7";
};
