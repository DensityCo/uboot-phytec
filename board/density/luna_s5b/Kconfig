## board/density/luna_s5b/Kconfig
```kconfig
if TARGET_DENSITY_LUNA_S5B

config SYS_BOARD
	default "luna_s5b"

config SYS_VENDOR
	default "density"

config SYS_CONFIG_NAME
	default "density_luna_s5b"

config CONS_INDEX
	int "UART used for console"
	range 1 6
	default 3
	help
	  The AM57x (and DRA7xx) SoC has a total of 6 UARTs available to it.
	  Depending on your specific board you may want something other than UART3
	  here.

endif
```

## board/phytec/am572x_phycore_rdk/Kconfig
```kconfig
if TARGET_AM572X_PHYCORE_RDK

config SYS_BOARD
	default "am572x_phycore_rdk"

config SYS_VENDOR
	default "phytec"

config SYS_CONFIG_NAME
	default "am572x_phycore_rdk"

config CONS_INDEX
	int "UART used for console"
	range 1 6
	default 3
	help
	  The AM57x (and DRA7xx) SoC has a total of 6 UARTs available to it.
	  Depending on your specific board you may want something other than UART3
	  here.

choice
	prompt "Select DDR3L Total Memory Size"
	default PCM_057_256M16_x4_DDR
	help
	  The phyCORE-AM572x SOM (PCM-057) can be populated with different DDR3
	  chips resulting in various configurations and total available memory.

	config PCM_057_256M16_x4_DDR
		bool "2GiB (4x 256M16)"
	config PCM_057_512M16_x4_DDR
		bool "4GiB (4x 512M16)"
endchoice

source "board/phytec/common/Kconfig"

endif
```

## board/phytec/am57xx_phycore_rdk/Kconfig
```kconfig
if TARGET_AM57XX_PHYCORE_RDK

config SYS_BOARD
	default "am57xx_phycore_rdk"

config SYS_VENDOR
	default "phytec"

config SYS_CONFIG_NAME
	default "am57xx_phycore_rdk"

config CONS_INDEX
	int "UART used for console"
	range 1 6
	default 3
	help
	  The AM57x (and DRA7xx) SoC has a total of 6 UARTs available to it.
	  Depending on your specific board you may want something other than UART3
	  here.

endif
```

## board/phytec/am65xx_phycore_kit/Kconfig
```kconfig
#
# Copyright (C) 2018 PHYTEC America, LLC
#
# SPDX-License-Identifier:     GPL-2.0+
#

choice
	prompt "PHYTEC phyCORE-AM65x based boards"
	optional

config TARGET_AM65XX_PHYCORE_KIT_R5
	bool "PHYTEC phyCORE-AM65x Kit (R5 processor)"
	select CPU_V7R
	select SYS_THUMB_BUILD
	select SOC_K3_AM6
	select K3_LOAD_SYSFW
	select K3_AM654_DDRSS
	imply K3_SPL_ATF

config TARGET_AM65XX_PHYCORE_KIT_A53
	bool "PHYTEC phyCORE-AM65x Kit (A53 processor)"
	select ARM64
	select SOC_K3_AM6
	select BOARD_LATE_INIT

endchoice

if TARGET_AM65XX_PHYCORE_KIT_R5

config SYS_BOARD
	default "am65xx_phycore_kit"

config SYS_VENDOR
	default "phytec"

config SYS_CONFIG_NAME
	default "am65xx_phycore_kit"

config SPL_LDSCRIPT
	default "arch/arm/mach-omap2/u-boot-spl.lds"

source "board/ti/common/Kconfig"

endif

if TARGET_AM65XX_PHYCORE_KIT_A53

config SYS_BOARD
	default "am65xx_phycore_kit"

config SYS_VENDOR
	default "phytec"

config SYS_CONFIG_NAME
	default "am65xx_phycore_kit"

source "board/ti/common/Kconfig"

endif
```

## board/phytec/common/Kconfig
```kconfig
config PHYTEC_EEPROM
	bool "Support for EEPROM-based board detection for PHYTEC platforms"
	default y

config NAND
	bool "Support for NAND on PHYTEC platforms"
	default n

if ARCH_OMAP2

config SPL_ENV_SUPPORT
	default y

config SPL_EXT_SUPPORT
	default y

config SPL_FAT_SUPPORT
	default y

config SPL_GPIO_SUPPORT
	default y

config SPL_I2C_SUPPORT
	default y

config SPL_LIBCOMMON_SUPPORT
	default y

config SPL_LIBDISK_SUPPORT
	default y

config SPL_LIBGENERIC_SUPPORT
	default y

config SPL_MMC_SUPPORT
	default y

config SPL_POWER_SUPPORT
	default y

config SPL_SERIAL_SUPPORT
	default y

endif
```

## configs/am57xx_phycore_rdk_defconfig
```kconfig
CONFIG_ARM=y
CONFIG_OMAP54XX=y
CONFIG_TARGET_AM57XX_PHYCORE_RDK=y
CONFIG_DM_SERIAL=y
CONFIG_DM_GPIO=y
CONFIG_ARMV7_LPAE=y
CONFIG_SPL_STACK_R_ADDR=0x82000000
CONFIG_DEFAULT_DEVICE_TREE="am57xx-phycore-rdk"
CONFIG_SPL=y
CONFIG_SPL_STACK_R=y
CONFIG_HUSH_PARSER=y
CONFIG_CMD_BOOTZ=y
# CONFIG_CMD_IMLS is not set
CONFIG_CMD_ASKENV=y
# CONFIG_CMD_FLASH is not set
CONFIG_CMD_MMC=y
CONFIG_CMD_SPI=y
CONFIG_CMD_I2C=y
CONFIG_CMD_USB=y
CONFIG_CMD_GPIO=y
# CONFIG_CMD_SETEXPR is not set
CONFIG_CMD_DHCP=y
CONFIG_CMD_MII=y
CONFIG_CMD_PING=y
CONFIG_CMD_REGULATOR=y
CONFIG_CMD_EXT2=y
CONFIG_CMD_EXT4=y
CONFIG_CMD_EXT4_WRITE=y
CONFIG_CMD_FAT=y
CONFIG_CMD_FS_GENERIC=y
CONFIG_OF_CONTROL=y
CONFIG_DM=y
CONFIG_DM_MMC=y
CONFIG_SPI_FLASH=y
CONFIG_SPI_FLASH_BAR=y
CONFIG_SYS_NS16550=y
CONFIG_USB=y
CONFIG_USB_DWC3=y
CONFIG_USB_DWC3_OMAP=y
CONFIG_USB_DWC3_PHY_OMAP=y
CONFIG_ERRNO_STR=y
CONFIG_FIT=y
CONFIG_SPL_OF_LIBFDT=y
CONFIG_SPL_LOAD_FIT=y
CONFIG_OF_LIST="am57xx-phycore-rdk"
CONFIG_OF_BOARD_SETUP=y
CONFIG_DRA7_DSPEVE_OPP_HIGH=y
CONFIG_DRA7_IVA_OPP_HIGH=y
CONFIG_DRA7_GPU_OPP_HIGH=y
CONFIG_DISK=y
CONFIG_DWC_AHCI=y
CONFIG_DM_ETH=y
CONFIG_DM_PMIC=y
CONFIG_PMIC_PALMAS=y
CONFIG_DM_REGULATOR=y
CONFIG_CMD_TIME=y
CONFIG_DM_I2C=y
CONFIG_DM_SPI=y
CONFIG_DM_SPI_FLASH=y
CONFIG_SPI_FLASH_STMICRO=y
CONFIG_TI_QSPI=y
CONFIG_CMD_SF=y
```
